## batocera-ax-external/package/cemu-latte-ax/Config.in
```kconfig
config BR2_PACKAGE_CEMU_LATTE_AX
	bool "cemu-latte-ax"
	depends on BR2_PACKAGE_AX_SDK
	help
	  Cemu Latte [AX] — Deterministic Nintendo Wii U emulator fork
	  powered by ax-sdk (libax_core) for Piccolo [AX].
```
